## sdkconfig.defaults
```kconfig
CONFIG_COMPILER_OPTIMIZATION_SIZE=y
# CONFIG_MESH_ENABLE_PS is not set
CONFIG_KEEMASH_NODE_V2_LOG_ENABLE=y
# CONFIG_KEEMASH_V2_COMPAT_TUNNEL_ENABLE is not set
CONFIG_KEEMASH_NODE_PSRAM_EXPECTED_BYTES=0
CONFIG_GARLAND_MESH_RELAY_ELIGIBLE=y
```
